// SPDX-License-Identifier: GPL-2.0-only
/*
* Copyright (c) 2023, Qualcomm Innovation Center, Inc. All rights reserved.
*/

#include "ipq9574-db-al01-c1.dts"

/ {
	config_name = "config@db-al01-c3", "config-db-al01-c3";

};

&phy_rst_pinmux {
	/delete-node/ qti_8081_rst;
};

/delete-node/ &phy5;

&mdio {
	phy5: phy@0 {
		reg = <0>;
		phy-mode = "usxgmii";
		phy_id = <2>;
		id = <6>;
		uniphy_id = <2>;
		uniphy_type = <0>;
		xgmac;
	};
};
