// SPDX-License-Identifier: GPL-2.0-only
/*
* Copyright (c) 2023, Qualcomm Innovation Center, Inc. All rights reserved.
*/

#include "ipq9574-rdp418.dts"

/ {
	config_name = "config@al02-c3","config@rdp437", "config-rdp437";

};

&pcie0_x1 {
	status = "okay";
	perst_gpio = <&tlmm 23 0>;
};

&pcie3_x2 {
	status = "disabled";
};
