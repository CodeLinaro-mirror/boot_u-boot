## arch/arm/mach-ipqsoc/Kconfig
```kconfig
if ARCH_IPQSOC

config ARCH_32BIT_SUPPORT
	bool "IPQSOC 32-bit support"
	select CPU_V7A
	select SYS_ARCH_TIMER
	default n

config ARCH_64BIT_SUPPORT
	bool "IPQSOC 64-bit support"
	select ARM64
	default n

config IPQ_SECURE
	bool "IPQSOC secure call support"
	default n

config VERSION_ROLLBACK_PARTITION_INFO
	bool "IPSOC Anti roll-back support"
	default n

config SYS_SOC
	default "ipqsoc"

config SMEM_VERSION_C
	bool "IPQSOC Shared memory version"
	default n

config SMEM_BASE_ADDR
	hex "Define memory for shared memory"

config NUM_ALT_PARTITION
	int
	default 16

config RAM_NUM_PART_ENTRIES
	int "Number of RAM partition entries which are usable by APPS"
	default 32

config SCM
	bool "add scm call support"

config RAM_PART_NAME_LENGTH
	int "Max length of ram partition name"
	default 16

config TEXT_SIZE
	hex "Define Size of u-boot text size in DDR region"
	default 0x200000

config IPQ_ELF_AUTH
	bool "IPQSOC elf image authentication"
	default n

config SOC_HW_VERSION_REG
	hex "Define SoC HW version register"
	default 0x194D000

config DPR_VER_1_0
	bool "DPR Version 1.0 support"
	default n

config DPR_VER_2_0
	bool "DPR Version 2.0 support"
	default n

config IPQ_DEFAULTS
	bool "Enable default configs & tool support for IPQ SOC"
	select OF_BOARD_SETUP
	select PINCTRL_QTI
	select CLK_QTI
	select BOARD_LATE_INIT
	select SYS_DEVICE_NULLDEV
	select ENV_IS_NOWHERE
	select IPQ_CRASHDUMP
	imply IPQ_MINIDUMP
	imply IPQ_COMPRESSED_CRASHDUMP
	imply IPQ_CRASHDUMP_TO_USB
	imply IPQ_CRASHDUMP_TO_MEMORY
	select IPQ_FLUTILS
	select IPQ_FDT_FIXUP
	select CMD_XIMG
	select CMD_MEMTEST
	select CMD_CACHE
	select DMA
	select DMA_CHANNELS
	select BAM_DMA
	select BOARD_TYPES
	select IPQ_SECURE
	select VERSION_ROLLBACK_PARTITION_INFO

config IPQ_I2C
	bool "Enable I2C support in IPQ SOC"
	select I2C
	select DM_I2C
	select SYS_I2C_QUP
	select CMD_I2C

config IPQ_MMC
	bool "Enable eMMC support in IPQ SOC"
	select MMC_SDHCI
	select MMC_SDHCI_MSM
	select MMC_SDHCI_ADMA
	imply MMC_HS200_SUPPORT
	select EFI_PARTITION
	select CMD_GPT
	select CMD_MMC

config IPQ_NAND
	bool "Enable NAND flash support in IPQ SOC"
	select QTI_BAM
	select NAND_QTI
	select DM_MTD
	select MTD_RAW_NAND
	select MTD_UBI
	select UBI_WRITE
	select CMD_MTD
	select CMD_NAND
	select CMD_UBI

config IPQ_SPI_NOR
	bool "Enable SPI NOR flash support in IPQ SOC"
	select SPI
	select SPI_QUP if TARGET_IPQ9574 || TARGET_IPQ5332
	select MSM_GENI_SPI if TARGET_DEVSOC
	select DM_SPI
	select DM_SPI_FLASH
	select SPI_FLASH_STMICRO
	select SPI_FLASH_GIGADEVICE
	select SPI_FLASH_MACRONIX
	select SPI_FLASH_WINBOND
	select SPI_FLASH_SPANSION
	select SPI_FLASH_MTD if ENV_IS_IN_SPI_FLASH

config IPQ_FLASH_PART_FIXUP
	bool "Enable Flash partition fixup support in IPQ SOC"
	select MTD
	select CMD_MTDPARTS
	select FDT_FIXUP_PARTITIONS

config IPQ_USB
	bool "Enable USB support in IPQ SOC"
	select USB
	select MISC
        select USB_HOST
	select USB_DWC3
	select USB_DWC3_GENERIC
        select USB_STORAGE
        select USB_XHCI_HCD
        select DM_USB
        select CMD_USB
	select CMD_FAT
	select FAT_WRITE

config IPQ_NET
	bool "Enable default Network Configurations for IPQ SOC"
	select ETH
	select DM_MDIO
	select MDIO_IPQ4019
	select PHYLIB
	select PHY_QTI
	select CMD_NET
	select CMD_MDIO
	select CMD_MII
	select CMD_PING
	select CMD_TFTPPUT
	select CMD_DHCP
	select TFTP_PORT

config ETH_MAX_MAC
	hex "Define Maximum MAC support in SoC"
	default 2

config IPQ_PCIE
	bool "Enable PCIE support in IPQ SOC"
	select PCI
	select PCIE_DW_QTI
	select CMD_PCI

config IPQ_QCN9224_FUSING
	depends on IPQ_PCIE
	bool "Enable QCN9224 Fusing"

config IPQ_MAX_PCIE
	int "Max PCIE supported in IPQSOC"
	depends on PCI
	default 3 if TARGET_IPQ5332
	default 4 if TARGET_IPQ9574

choice
	prompt "IPQ board select"

config TARGET_IPQ5332
	bool "QTI IPQ5332 SOC"
	select SMEM_VERSION_C
	select SCM
	select IPQ_DEFAULTS
	imply IPQ_I2C
	select IPQ_NET
	select QTI_NSS_SWITCH
	select PHY_QTI_8X8X
	select PHY_QTI_8081
	select IPQ_ELF_AUTH
	imply IPQ_PCIE
	select PHY if IPQ_USB
        select PHY_QTI_USB_HS_M31 if IPQ_USB
        select PHY_QTI_UNI_SSPHY if IPQ_USB
        select IPQ_QCN9224_FUSING
	select DPR_VER_2_0
	help
	  Support for the IPQ53XX SoC.
	  - Board Open Platform Specifications.
	  - Quad Cores A53, Nom@1.2G ,Turbo@1.5G, L1@32KB L2@512KB
	  - DDR3L/DDR4
	  - QSPI NAND / NOR / eMMC
	  - USB 3.0/I2C/UART/PCIe Gen3 2Lane
	  - 1G/2.5G/10G Ethernet Ports

config TARGET_IPQ9574
	bool "QTI IPQ9574 SOC"
	select SMEM_VERSION_C
	select SCM
	select IPQ_DEFAULTS
	imply IPQ_I2C
	select IPQ_NET
	select QTI_NSS_SWITCH
	select PHY_QTI_8075
	select PHY_QTI_8X8X
	select PHY_QTI_8081
	select PHY_AQUANTIA
	select IPQ_ELF_AUTH
	imply IPQ_PCIE
	select PHY if IPQ_PCIE || IPQ_USB
	select PHY_QTI_QMP_PCIE
        select PHY_QTI_QUSB2 if IPQ_USB
        select PHY_QTI_QMP_USB3 if IPQ_USB
        select IPQ_QCN9224_FUSING
	select DPR_VER_1_0
	help
	  Support for IPQ95xx SoC.
	  - Board Open Platform Specifications.
	  - Quad Cores A73, max@2.2G, L1@32KB L2@512KB
	  - DDR3L/DDR4
	  - QSPI NAND / NOR / eMMC
	  - USB 3.0/I2C/UART/PCIe Gen3 2Lane
	  - 1G/2.5G/10G Ethernet Ports

config TARGET_DEVSOC
	bool "QTI DEVSOC"
	select SMEM_VERSION_C
	select SCM
	select OF_BOARD_SETUP
	select PINCTRL_QTI
	select CLK_QTI
	select BOARD_LATE_INIT
	select SYS_DEVICE_NULLDEV
	select ENV_IS_NOWHERE
	select CMD_MEMTEST
	select CMD_CACHE
	select DMA
	select DMA_CHANNELS
	select BOARD_TYPES
	help
	  Support for IPQ DEVSoC.

endchoice

source "board/qti/common/Kconfig"
source "board/qti/ipq5332/Kconfig"
source "board/qti/ipq9574/Kconfig"
source "board/qti/devsoc/Kconfig"

endif
```

## arch/arm/mach-snapdragon/Kconfig
```kconfig
if ARCH_SNAPDRAGON

config SYS_SOC
	default "snapdragon"

config SYS_VENDOR
	string "Snapdragon board vendor"
	default "qualcomm"
	help
	  Allows to specify vendor for the Snapdragon SoCs based boards.
	  Based on this option board/<CONFIG_SYS_VENDOR>/<CONFIG_SYS_BOARD>
	  will be used as the custom board directory.

config SYS_MALLOC_LEN
	default 0x10000000

config SYS_MALLOC_F_LEN
	default 0x2000

config SPL_SYS_MALLOC_F
	default y

config SPL_SYS_MALLOC_F_LEN
	default 0x2000

config SYS_MALLOC_LEN
	default 0x800000

config LNX_KRNL_IMG_TEXT_OFFSET_BASE
	default 0x80000000

config OF_LIVE_QCS615
        bool "Enable OF LIVE QCS615"
        select OF_LIVE
        help
          Say Y here to enable support for OF LIVE fixups
          on the Snapdragon QCS615 SoC.

config OF_LIVE_SA8775P
        bool "Enable OF LIVE SA8775P"
        select OF_LIVE
        help
          Say Y here to enable support for OF LIVE fixups
          on the Snapdragon SA8775 SoC.

config OF_LIVE_SC7280
        bool "Enable OF LIVE SC7280"
        select OF_LIVE
        help
          Say Y here to enable support for OF LIVE fixups
          on the Snapdragon SC7280 SoC.

config QCOM_USB_FIXUP
	bool "Enable USB speed fixup for Qualcomm platforms"
	default y
	help
	  Enable runtime fixup of USB device tree nodes to limit USB to
	  high-speed mode. This is needed on some Qualcomm platforms where
	  U-Boot doesn't support super-speed USB.
	  Disable this for platforms that have proper super-speed USB support
	  in U-Boot.

config SYS_BOARD
	string "Snapdragon SoCs based board"
	help
	  Allows to specify the Snapdragon SoCs based board name.
	  Based on this option board/<CONFIG_SYS_VENDOR>/<CONFIG_SYS_BOARD>
	  will be used as the custom board directory.

config SYS_CONFIG_NAME
	string "Board configuration name"
	default SYS_BOARD if SYS_BOARD != ""
	default "qcom"
	help
	  This option contains information about board configuration name.
	  Based on this option include/configs/<CONFIG_SYS_CONFIG_NAME>.h header
	  will be used for board configuration.

config QCOM_FIT_MULTIDTB
	bool "Enable FIT multi-DTB selection for Qualcomm platforms"
	depends on FIT
	help
	  Enable FIT multi-DTB selection for Qualcomm platforms.
	  This allows U-Boot to select the appropriate device tree
	  from a FIT image.

config QCOM_IMEM_SIZE
	hex "QCOM IMEM size"
	default 0x0
	help
	  Platform-specific IMEM size for calculating shared IMEM base address.

endif
```

## board/qti/common/Kconfig
```kconfig
config IPQ_CRASHDUMP
	bool "IPQ Crashdump collection support"
	depends on USE_PREBOOT
	default n

config IPQ_MINIDUMP
	bool "IPQ Minidump collection support"
	depends on IPQ_CRASHDUMP
	default n

config IPQ_COMPRESSED_CRASHDUMP
	bool "IPQ Compressed (GZIP) Crashdump support"
	depends on IPQ_CRASHDUMP
	select CMD_ZIP
	default n

config IPQ_CRASHDUMP_TO_USB
	bool "IPQ Collect Crashdump over USB"
	depends on IPQ_CRASHDUMP && IPQ_USB
	default n

config IPQ_CRASHDUMP_TO_MEMORY
	bool "IPQ Collect Crashdump over DDR Memory"
	depends on IPQ_CRASHDUMP
	default n

config IPQ_FLUTILS
	bool "IPQ Flash Utility support"
	default n

config IPQ_FDT_FIXUP
	bool "IPQ FDT Fixup support"
	default n
```

## board/qti/devsoc/Kconfig
```kconfig
if TARGET_DEVSOC

config SYS_BOARD
	default "devsoc"

config SYS_VENDOR
	default "qti"

config SYS_SOC
	default "devsoc"

config SYS_CONFIG_NAME
	default "devsoc"

endif
```

## configs/qcom_qcs9075_defconfig
```kconfig
#include "qcs9100_defconfig"

CONFIG_DEFAULT_DEVICE_TREE="qcom/qcs9075-iq-9075-evk"
```
